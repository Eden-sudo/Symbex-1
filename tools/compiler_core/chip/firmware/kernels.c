/*
 * kernels.c -- firmware of the kernel benchmark (chip/kernels.py): measures, on THIS chip, every way the library
 * can compute a layer, on synthetic layers of N_OUT neurons and SEVERAL row widths (kernels_data.h, generated by
 * kernels.py: the weights of every width, in flash by default -- as in a real deployment -- or copied to RAM with
 * KERNELS_WEIGHTS_IN_RAM). Inputs live in RAM, as they do in a model.
 *
 *   binary layers   xnor          XNOR + popcount, one call per layer (symbex_dense_forward)
 *                   and_pad       AND + count, rows padded to a multiple of 4 words (16-byte rows, PIE on the S3)
 *                   and_nopad     AND + count, rows of exactly ceil(n_in / 32) words
 *   first layer     first_mask    uint8 input, XNOR layout, mask method (symbex_dense_input_u8_mask)
 *                   first_planes  uint8 input, XNOR layout, 8 bit planes (symbex_dense_input_u8_planes)
 *                   first_and_pad / first_and_nopad   uint8 input, AND path (symbex_and_input_u8)
 *   reference       int8          (only with KERNELS_WITH_INT8) INT8 multiply-accumulate with Espressif's ESP-NN,
 *                                 on the same layer sizes (its weights in RAM: heap)
 *
 * Every kernel prints "K:<name>,<n_in>,<ns per call>,<checksum>". All binary kernels compute the same dot products
 * (and so do all first-layer kernels): their checksums must match. Small layers are run ITER times per sample so
 * that every sample covers ~65,000 weights (the timer has 1 us resolution).
 * chip/core.py writes BAUD_RATE before this file; kernels.py writes kernels_data.h next to it.
 */
#include <stdio.h>
#include <stdint.h>
#include <string.h>
#include "freertos/FreeRTOS.h"
#include "freertos/task.h"
#include "esp_timer.h"
#include "esp_log.h"
#include "esp_heap_caps.h"
#ifdef KERNELS_WITH_INT8
#include "esp_nn.h"
#endif
#include "hal/symbex_hal.h"
#include "ops/symbex_and.h"
#include "layers/dense/symbex_dense.h"
#include "kernels_data.h"          /* N_OUT, N_SHAPES, MAX_WORDS, MAX_STRIDE, struct KShape SHAPES[] */

#define REP 15

#ifdef KERNELS_WEIGHTS_IN_RAM
static uint32_t ram_x[N_OUT * MAX_WORDS] __attribute__((aligned(16)));
static uint32_t ram_a[N_OUT * MAX_STRIDE] __attribute__((aligned(16)));
#endif
static uint32_t a[MAX_STRIDE] __attribute__((aligned(16)));
static uint8_t x[MAX_STRIDE * 32] __attribute__((aligned(16)));   /* aligned: the SWAR first layer reads 4 inputs at once */
static uint8_t work[MAX_STRIDE * 32] __attribute__((aligned(16)));
static uint32_t planes[8 * MAX_WORDS];
static int32_t raw[N_OUT];
#ifdef KERNELS_WITH_INT8
static int8_t *w8, *x8, *o8;
static int32_t* b32;
#endif

/* the shape being measured */
static int n_in, words, stride;
static const uint32_t *wx, *wa;
static const int32_t* cnt;

static int32_t checksum(void) { int32_t s = 0; for (int j = 0; j < N_OUT; j++) s += raw[j] * (j + 1); return s; }

static int32_t k_xnor(void) {                         /* the layer as the models run it: one call per layer */
    struct SymbexLayerData L = { (uint16_t)n_in, N_OUT, 1, wx };
    symbex_dense_forward(a, raw, &L);
    return checksum();
}
static int32_t k_and_pad(void) { symbex_and_raw(a, n_in, wa, stride, N_OUT, cnt, raw); return checksum(); }
static int32_t k_and_nopad(void) { symbex_and_raw(a, n_in, wx, words, N_OUT, cnt, raw); return checksum(); }
static int32_t k_first_mask(void) {
    struct SymbexLayerData L = { (uint16_t)n_in, N_OUT, 1, wx };
    symbex_dense_input_u8_mask(x, raw, &L);
    return checksum();
}
static int32_t k_first_planes(void) {
    struct SymbexLayerData L = { (uint16_t)n_in, N_OUT, 1, wx };
    symbex_dense_input_u8_planes(x, planes, raw, &L);
    return checksum();
}
static int32_t k_first_and_pad(void) { symbex_and_input_u8(x, n_in, wa, stride, N_OUT, work, raw); return checksum(); }
static int32_t k_first_and_nopad(void) { symbex_and_input_u8(x, n_in, wx, words, N_OUT, work, raw); return checksum(); }
#ifdef KERNELS_WITH_INT8
static int32_t k_int8(void) {
    esp_nn_fully_connected_s8(x8, 0, n_in, w8, 0, b32, o8, N_OUT, 0, 0, 1 << 30, -128, 127);
    return o8[0];
}
#endif

typedef int32_t (*kernel_t)(void);
static void measure(const char* name, kernel_t k) {
    const int iter = 1 + 65536 / (N_OUT * n_in);
    int64_t t[REP]; int32_t c = 0;
    k();                                          /* warm-up: tables, caches */
    for (int r = 0; r < REP; r++) {
        int64_t s = esp_timer_get_time();
        for (int i = 0; i < iter; i++) c = k();
        t[r] = esp_timer_get_time() - s;
    }
    for (int i = 1; i < REP; i++) for (int j = i; j > 0 && t[j] < t[j - 1]; j--) { int64_t z = t[j]; t[j] = t[j - 1]; t[j - 1] = z; }
    printf("K:%s,%d,%lld,%ld\n", name, n_in, (long long)(t[REP / 2] * 1000 / iter), (long)c);
    fflush(stdout);
}

void app_main(void) {
    esp_log_level_set("*", ESP_LOG_WARN);
    vTaskDelay(pdMS_TO_TICKS(300));
    printf("\nKERNELS ready | %s | %d neurons, %d widths, weights in %s\n", symbex_hal_name(), N_OUT, N_SHAPES,
#ifdef KERNELS_WEIGHTS_IN_RAM
           "RAM"
#else
           "flash"
#endif
    );
    fflush(stdout);
    uint32_t r = 12345;
    #define RAND() (r = r * 1103515245u + 12345u)
#ifdef KERNELS_WITH_INT8
    const int caps = MALLOC_CAP_INTERNAL | MALLOC_CAP_8BIT;
    w8 = heap_caps_aligned_alloc(16, N_OUT * MAX_WORDS * 32, caps); x8 = heap_caps_aligned_alloc(16, MAX_WORDS * 32, caps);
    o8 = heap_caps_aligned_alloc(16, N_OUT, caps); b32 = heap_caps_aligned_alloc(16, 4 * N_OUT, caps);
    if (w8 && x8 && o8 && b32) {
        for (int i = 0; i < N_OUT * MAX_WORDS * 32; i++) w8[i] = (int8_t)(RAND() >> 24);
        for (int i = 0; i < MAX_WORDS * 32; i++) x8[i] = (int8_t)(RAND() >> 24);
        memset(b32, 0, 4 * N_OUT);
    }
#endif
    for (int s = 0; s < N_SHAPES; s++) {
        n_in = SHAPES[s].n_in; words = SHAPES[s].words; stride = SHAPES[s].stride; cnt = SHAPES[s].count;
#ifdef KERNELS_WEIGHTS_IN_RAM
        memcpy(ram_x, SHAPES[s].wx, 4 * N_OUT * words); memcpy(ram_a, SHAPES[s].wa, 4 * N_OUT * stride);
        wx = ram_x; wa = ram_a;
#else
        wx = SHAPES[s].wx; wa = SHAPES[s].wa;
#endif
        memset(a, 0, sizeof a);
        for (int i = 0; i < n_in; i++) { if ((RAND() >> 16) & 1) a[i / 32] |= 1u << (i % 32); x[i] = (uint8_t)(RAND() >> 24); }
        measure("xnor", k_xnor);
        measure("and_pad", k_and_pad);
        measure("and_nopad", k_and_nopad);
        measure("first_mask", k_first_mask);
        measure("first_planes", k_first_planes);
        measure("first_and_pad", k_first_and_pad);
        measure("first_and_nopad", k_first_and_nopad);
#ifdef KERNELS_WITH_INT8
        if (w8 && x8 && o8 && b32) measure("int8", k_int8);
#endif
    }
    printf("DONE\n");
    fflush(stdout);
    while (1) vTaskDelay(portMAX_DELAY);
}
